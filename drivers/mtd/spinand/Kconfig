## drivers/mtd/spinand/Kconfig
```kconfig
#
# linux/drivers/mtd/spinand/Kconfig
#

menuconfig MTD_SPINAND
	tristate "SPINAND Device Support"
	depends on MTD
	help
	  This enables support for accessing Micron SPI NAND flash
	  devices.

if MTD_SPINAND

config MTD_SPINAND_ONDIEECC
	bool "Use SPINAND internal ECC"
	help
	 Internel ECC

config MTD_SPINAND_SWECC
	bool "Use software ECC"
	depends on MTD_NAND
	help
	 software ECC

config MTD_SPI1_MT29F
   bool "Configure MT29F on SPI1"
   depends on MTD_SPINAND

config MTD_SPI1_1_MT29F
   bool "Configure second MT29F on SPI1.1"
   depends on MTD_SPINAND
   depends on MTD_SPI1_MT29F

endif
```
